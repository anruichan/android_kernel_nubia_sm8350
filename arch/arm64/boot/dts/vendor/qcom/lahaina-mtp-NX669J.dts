/dts-v1/;

#define CONFIG_BOARD_NUBIA_LAHAINA

#include "lahaina.dtsi"
#include "lahaina-mtp.dtsi"
#include "nubia/NX669J/head.dtsi"

/ {
	model = "Qualcomm Technologies, Inc. Lahaina MTP";
	compatible = "qcom,lahaina-mtp", "qcom,lahaina", "qcom,mtp";
	qcom,board-id = <0x10008 0>;
};
